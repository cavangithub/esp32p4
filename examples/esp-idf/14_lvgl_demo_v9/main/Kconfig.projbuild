## examples/esp-idf/14_lvgl_demo_v9/main/Kconfig.projbuild
```kconfig
menu "Example Configuration"

    choice EXAMPLE_LCD_PANEL
        prompt "LCD panel"
        default EXAMPLE_LCD_PANEL_WAVESHARE
        help
            Select which display this example initializes. Only one MIPI-DSI
            panel can be active at a time.

        config EXAMPLE_LCD_PANEL_WAVESHARE
            bool "Waveshare DSI LCD"
            help
                Use the LCD type selected under Board Support Package(ESP32-P4).
                This example defaults to the 7-inch 720x1280 panel.

        config EXAMPLE_LCD_PANEL_AMS495QA04
            bool "Samsung AMS495QA04 4.95\" AMOLED (960x544)"
            help
                River-board AMOLED over MIPI-DSI. Native landscape 960x544,
                RGB565, touchless, no backlight. Requires VDD then VCI
                power-up and the Samsung MCS init sequence.
    endchoice

    config EXAMPLE_AMS495QA04_RST_GPIO
        int "AMS495QA04 reset GPIO (active low)"
        depends on EXAMPLE_LCD_PANEL_AMS495QA04
        default 32
        range -1 54
        help
            Panel RESETB. Set to -1 to use DCS software reset instead.

    config EXAMPLE_AMS495QA04_VCI_EN_GPIO
        int "AMS495QA04 VCI enable GPIO"
        depends on EXAMPLE_LCD_PANEL_AMS495QA04
        default 21
        range 0 54
        help
            Load-switch enable for the panel +3.3 V VCI rail.

    config EXAMPLE_AMS495QA04_VDD_EN_GPIO
        int "AMS495QA04 VDD enable GPIO"
        depends on EXAMPLE_LCD_PANEL_AMS495QA04
        default 22
        range 0 54
        help
            Load-switch enable for the panel +1.8 V VDD rail.

    config ESP_WIFI_SSID
        string "WiFi SSID"
        default "myssid"
        help
            SSID (network name) for the example to connect to.

    config ESP_WIFI_PASSWORD
        string "WiFi Password"
        default "mypassword"
        help
            WiFi password (WPA or WPA2) for the example to use.

    choice ESP_WIFI_SAE_MODE
        prompt "WPA3 SAE mode selection"
        default ESP_WPA3_SAE_PWE_BOTH
        help
            Select mode for SAE as Hunt and Peck, H2E or both.
        config ESP_WPA3_SAE_PWE_HUNT_AND_PECK
            bool "HUNT AND PECK"
        config ESP_WPA3_SAE_PWE_HASH_TO_ELEMENT
            bool "H2E"
        config ESP_WPA3_SAE_PWE_BOTH
            bool "BOTH"
    endchoice

    config ESP_WIFI_PW_ID
        string "PASSWORD IDENTIFIER"
        depends on  ESP_WPA3_SAE_PWE_HASH_TO_ELEMENT|| ESP_WPA3_SAE_PWE_BOTH
        default ""
        help
            password identifier for SAE H2E

    config ESP_MAXIMUM_RETRY
        int "Maximum retry"
        default 5
        help
            Set the Maximum retry to avoid station reconnecting to the AP unlimited when the AP is really inexistent.

    choice ESP_WIFI_SCAN_AUTH_MODE_THRESHOLD
        prompt "WiFi Scan auth mode threshold"
        default ESP_WIFI_AUTH_WPA2_PSK
        help
            The weakest authmode to accept in the scan mode.
            This value defaults to ESP_WIFI_AUTH_WPA2_PSK incase password is present and ESP_WIFI_AUTH_OPEN is used.
            Please select ESP_WIFI_AUTH_WEP/ESP_WIFI_AUTH_WPA_PSK incase AP is operating in WEP/WPA mode.

        config ESP_WIFI_AUTH_OPEN
            bool "OPEN"
        config ESP_WIFI_AUTH_WEP
            bool "WEP"
        config ESP_WIFI_AUTH_WPA_PSK
            bool "WPA PSK"
        config ESP_WIFI_AUTH_WPA2_PSK
            bool "WPA2 PSK"
        config ESP_WIFI_AUTH_WPA_WPA2_PSK
            bool "WPA/WPA2 PSK"
        config ESP_WIFI_AUTH_WPA3_PSK
            bool "WPA3 PSK"
        config ESP_WIFI_AUTH_WPA2_WPA3_PSK
            bool "WPA2/WPA3 PSK"
        config ESP_WIFI_AUTH_WAPI_PSK
            bool "WAPI PSK"
    endchoice

endmenu
```
